## main/Kconfig.projbuild
```kconfig
menu "Raspberry Pi Camera"

    config RPI_TCP_SERVER_IP
        string "TCP receiver IPv4"
        default "192.168.1.10"
        help
            Receiver host IPv4 address for telemetry upload.

    config RPI_TCP_SERVER_PORT
        int "TCP receiver port"
        range 1 65535
        default 9000
        help
            Receiver listening TCP port.

    config RPI_NODE_ID
        int "Node ID"
        range 1 65535
        default 1
        help
            Unique node identifier used by receiver to sort data.

    config RPI_ETH_USE_STATIC_IP
        bool "Use static IPv4 on Ethernet"
        default y
        help
            Enable for a direct PC cable (no DHCP server). Disable on a network
            that assigns addresses via DHCP.

    config RPI_ETH_STATIC_IP
        string "ESP Ethernet IPv4"
        depends on RPI_ETH_USE_STATIC_IP
        default "192.168.1.20"
        help
            Static address for this board. Must be on the same subnet as the PC.

    config RPI_ETH_STATIC_GW
        string "Ethernet gateway IPv4"
        depends on RPI_ETH_USE_STATIC_IP
        default "192.168.1.10"
        help
            Usually the PC running tcp_receiver.py (same as TCP receiver IP).

    config RPI_ETH_STATIC_NETMASK
        string "Ethernet netmask"
        depends on RPI_ETH_USE_STATIC_IP
        default "255.255.255.0"

    config RPI_CTRL_TCP_PORT
        int "Master control TCP port (slave listens)"
        range 1 65535
        default 9001
        help
            Port on which the ESP slave listens for master commands.

    config RPI_OTA_TCP_PORT
        int "Ethernet OTA TCP port (slave listens)"
        range 1 65535
        default 3232
        help
            Port for uploading a new app .bin after the first USB flash.
            Used by: python tcp_master.py --host <ip> ota

    config RPI_OTA_REBOOT_DELAY_MS
        int "Delay before reboot after successful OTA (ms)"
        range 100 10000
        default 500

    config RPI_OTA_REQUIRE_VERSION_INCREMENT
        bool "Reject OTA image with same app version as running firmware"
        default n
        help
            When enabled, esp_app_desc.version in the uploaded image must differ
            from the currently running firmware.

endmenu
```

## sdkconfig.defaults.esp32p4
```kconfig
# ESP32-P4 Wi-Fi remote (ESP32-C6 slave over SDIO)
CONFIG_WIFI_RMT_STATIC_RX_BUFFER_NUM=16
CONFIG_WIFI_RMT_DYNAMIC_RX_BUFFER_NUM=64
CONFIG_WIFI_RMT_DYNAMIC_TX_BUFFER_NUM=64
CONFIG_WIFI_RMT_AMPDU_TX_ENABLED=y
CONFIG_WIFI_RMT_TX_BA_WIN=32
CONFIG_WIFI_RMT_AMPDU_RX_ENABLED=y
CONFIG_WIFI_RMT_RX_BA_WIN=32
```

## sdkconfig.defaults.pre_v3
```kconfig
# ESP32-P4 engineering samples earlier than rev v3.0 (e.g. rev v1.3).
# Supports rev v0.x and v1.x chips only — not v3.x production chips.
CONFIG_ESP32P4_SELECTS_REV_LESS_V3=y
CONFIG_ESP32P4_REV_MIN_1=y
```

## sdkconfig.defaults.slave2
```kconfig
# Overlay for second camera slave (flash with SDKCONFIG_DEFAULTS including this file).
# Slave 1 (default): node 1 @ 192.168.1.20
# Slave 2:          node 2 @ 192.168.1.21
# PC receiver stays 192.168.1.10 — both slaves uplink to the same tcp_receiver.py.

CONFIG_RPI_NODE_ID=2
CONFIG_RPI_ETH_STATIC_IP="192.168.1.21"
CONFIG_RPI_ETH_STATIC_GW="192.168.1.10"
CONFIG_RPI_ETH_STATIC_NETMASK="255.255.255.0"
```
